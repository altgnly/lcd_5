	LIST P=16F877A
	#INCLUDE <P16F877A.INC>
	SAYICI1 EQU 0X20
	SAYICI2 EQU 0X21
	DEG_LCD EQU 0X22
	SAYICI EQU 0X23

	ORG 0X00
	GOTO ANA_METOT

ANA_METOT
	BANKSEL TRISB
	CLRF TRISB
	BANKSEL PORTB
	CLRF PORTB
	
	CLRF SAYICI
	CALL LCD_AYARLAR
	
KONTROL
	BTFSC PORTB,6
	CALL YAZ
	BTFSC PORTB,7
	CALL SIL
	GOTO KONTROL

DONGU
	GOTO DONGU

YAZ
	MOVLW H'06'
	CALL KOMUTYAZ
	CALL GECIKME
	MOVF SAYICI,W
	CALL TABLO1
	CALL VERIYAZ
	INCF SAYICI,F
	RETURN

SIL
	MOVLW H'04'
	CALL KOMUTYAZ
	CALL GECIKME
	MOVLW D'5'
	SUBWF SAYICI,W
	BTFSC STATUS,Z
	GOTO ONSATIR
	CALL TABLO2
	CALL VERIYAZ
	DECF SAYICI,F
	RETURN

ONSATIR
	MOVLW H'85'
	CALL KOMUTYAZ
	DECF SAYICI,F
	RETURN

SATIR2
	INCF SAYICI,F
	MOVLW H'C0'
	CALL KOMUTYAZ
	RETURN

KOMUTYAZ
	MOVWF DEG_LCD
	SWAPF DEG_LCD,W
	CALL KOMUTGONDER
	MOVF DEG_LCD,W
	CALL KOMUTGONDER
	RETURN

KOMUTGONDER
	ANDLW 0X0F
	MOVWF PORTB
	BCF PORTB,4
	BSF PORTB,5
	CALL GECIKME
	BCF PORTB,5
	RETURN

VERIYAZ
	MOVWF DEG_LCD	
	SWAPF DEG_LCD,W
	CALL VERIGONDER
	MOVF DEG_LCD,W
	CALL VERIGONDER
	RETURN

VERIGONDER
	ANDLW 0X0F
	MOVWF PORTB
	BSF PORTB,4
	BSF PORTB,5
	CALL GECIKME
	BCF PORTB,5
	RETURN

LCD_AYARLAR
	MOVLW H'02'
	CALL KOMUTYAZ
	
	MOVLW H'0E'
	CALL KOMUTYAZ
	
	MOVLW H'01'
	CALL KOMUTYAZ

	MOVLW H'28'
	CALL KOMUTYAZ

	RETURN
	
TABLO1
	ADDWF PCL,F
	RETLW 'N'
	RETLW 'I'
	RETLW 'L'
	RETLW 'A'
	RETLW 'Y'
	
	CALL SATIR2
	
	RETLW 'N'
	RETLW 'I'
	RETLW 'L'
	RETLW 'A'
	RETLW 'Y'
	
TABLO2
	RETLW ' '
	RETLW 0X00

GECIKME	
	MOVLW D'250'
	MOVWF SAYICI1

TEKRAR1
	MOVLW D'100'
	MOVWF SAYICI2

TEKRAR2
	DECFSZ SAYICI2,F
	GOTO TEKRAR2
	DECFSZ SAYICI1,F
	GOTO TEKRAR1
	RETURN

END
	